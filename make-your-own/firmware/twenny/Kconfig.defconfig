## make-your-own/firmware/twenny/Kconfig.defconfig
```kconfig
config ZMK_PM_SOFT_OFF
	default y
config ZMK_POINTING
	default y

if SHIELD_TWENNY_LEFT

config ZMK_KEYBOARD_NAME
	default "twenny_left"

config ZMK_SPLIT_ROLE_CENTRAL
	default y

endif

if SHIELD_TWENNY_LEFT || SHIELD_TWENNY_RIGHT

config ZMK_SPLIT
	default y

endif
```

## make-your-own/firmware/twenny/Kconfig.shield
```kconfig
config SHIELD_TWENNY_LEFT
	def_bool $(shields_list_contains,twenny_left)
config SHIELD_TWENNY_RIGHT
	def_bool $(shields_list_contains,twenny_right)
```
